## Config.in
```kconfig
################################################################################
# SPDX-License-Identifier: LGPL-3.0-only
#
# This file is part of InCfg.
# Copyright (C) 2024 Grégor Boirie <gregor.boirie@free.fr>
################################################################################

config INCFG_ASSERT_API
	bool "API assertion"
	default n
	help
	  Build incfg library with high-level API assertions enabled to ensure
	  that API functions exposed by incfg will perform full verification of
	  arguments consistency.

config INCFG_ASSERT_INTERN
	bool "Internal assertion"
	select INCFG_ASSERT_API
	default n
	help
	  Build incfg library with internal assertions enabled to check for
	  internal incfg behavioral consistency.

config INCFG_ENABLED
	bool
	default n

config INCFG_IPV4
	bool "IPv4 support"
	default y
	select INCFG_ENABLED
	help
	  Build incfg library with support for IPv4.

config INCFG_IPV6
	bool "IPv6 support"
	default y
	select INCFG_ENABLED
	help
	  Build incfg library with support for IPv6.

config INCFG_DNAME
	bool "Domain name support"
	default y
	select INCFG_ENABLED
	help
	  Build incfg library with support for Domain names.

config INCFG_IP
	bool "IP support"
	default y
	depends on INCFG_IPV4 || INCFG_IPV6
	help
	  Build incfg library with support for IP address expressed as
	  either IPv4 or IPv6 address.

config INCFG_DEBUG
	bool "Debug"
	select INCFG_ASSERT_API
	select INCFG_ASSERT_INTERN
	default n
	help
	  Build incfg library with internal debugging support enabled.

config INCFG_UTEST
	bool "Unit tests"
	depends on INCFG_ENABLED
	default n
	help
	  Build InCfg library unit testsuite.

config INCFG_VALGRIND
	bool "Valgrind support"
	depends on INCFG_UTEST
	default n
	help
	  Build InCfg library unit test suite with Valgrind support enabled.
	  For debugging purposes only: do not use in production.

# ex: ft=kconfig:
```
